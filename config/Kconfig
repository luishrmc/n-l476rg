## config/Kconfig
```kconfig
mainmenu "Project Configuration"

menu "Project"
config PROJECT_NAME
	string "Project Name"
	default "@PROJECT_NAME@"

config PROJECT_VERSION
	string "Project Version"
	default "@PROJECT_VERSION@"

config PROJECT_BUILD
	string "Project Build Type"
	default "@CMAKE_BUILD_TYPE@"
endmenu

menu "Application"
rsource "controllers/Kconfig"
rsource "drivers/Kconfig"
rsource "services/Kconfig"
endmenu
```

## config/drivers/Kconfig
```kconfig
menu "Drivers"

menu "USART"
menu "USART 1"

config USART1_TX
	int "TX PIN"
	default 9

config USART1_RX
	int "RX PIN"
	default 10

config USART1_PORT
	string "PORT"
	default "GPIOA"

endmenu

menu "USART 2"
config USART2_TX
	int "TX PIN"
	default 2

config USART2_RX
	int "RX PIN"
	default 3

config USART2_PORT
	string "PORT"
	default "GPIOA"

endmenu
endmenu

endmenu
```
